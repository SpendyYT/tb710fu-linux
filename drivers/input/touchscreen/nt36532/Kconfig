## drivers/input/touchscreen/nt36532/Kconfig
```kconfig
#
# Novatek NT36536 touchscreen driver configuration
#
config TOUCHSCREEN_NT36532_SPI
	tristate "Novatek NT36532 host download SPI driver"
	default n
	help
	  Say Y here if you have a Novatek NT36536 no flash touchscreen connected
	  to your system by SPI bus.

	  If unsure, say N.
```
